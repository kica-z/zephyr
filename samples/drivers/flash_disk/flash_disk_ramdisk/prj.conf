## CMakeLists.txt
```
# SPDX-License-Identifier: Apache-2.0

cmake_minimum_required(VERSION 3.20.0)
find_package(Zephyr REQUIRED HINTS $ENV{ZEPHYR_BASE})
project(flash_disk)

zephyr_library_include_directories(${ZEPHYR_BASE}/drivers/flash)

FILE(GLOB app_sources src/*.c)
target_sources(app PRIVATE ${app_sources})
```

## prj.conf
```kconfig
CONFIG_FLASH=y
CONFIG_MINIMAL_LIBC=y

# Enable flash on disk
CONFIG_FLASH_DRIVER_DISK=y

# RAM-Disk config
CONFIG_DISK_ACCESS=y
CONFIG_DISK_DRIVERS=y
CONFIG_DISK_DRIVER_RAM=y
CONFIG_DISK_RAM_VOLUME_NAME="DISK1"
CONFIG_DISK_RAM_VOLUME_SIZE=1

# Logging
CONFIG_LOG=y
```

## app.overlay
```dts
/*
 * Copyright (c) 2022-2023 Nordic Semiconductor ASA
 *
 * SPDX-License-Identifier: Apache-2.0
 */

 / { 
	disk_flash_example: disk_flash_example {
		compatible = "zephyr,disk-flash";
		status = "okay";
		size = <4096>;
		init-level = "APPLICATION";
		init-priority = <45>;
		write-block-size = <1>;
		page-size = <4096>;
		disk-name = "DISK1";
		disk-sector-size = <512>;
		disk-offset = <512>;
	};
};
```

## src/main.c
```c
/*
 * Copyright (c) 2023 Endress+Hauser AG
 *
 * SPDX-License-Identifier: Apache-2.0
 */

#include <zephyr/kernel.h>
#include <zephyr/device.h>
#include <zephyr/drivers/flash.h>
#include <zephyr/logging/log.h>

#if DT_HAS_COMPAT_STATUS_OKAY(zephyr_disk_flash)
#define FLASH_NODE DT_COMPAT_GET_ANY_STATUS_OKAY(zephyr_disk_flash)
#else
#error Unsupported flash driver
#define FLASH_NODE DT_INVALID_NODE
#endif

LOG_MODULE_REGISTER(main, CONFIG_LOG_DEFAULT_LEVEL);

int main(void)
{
	int res = 0;
	const struct device *const dev = DEVICE_DT_GET(FLASH_NODE);

	if (!device_is_ready(dev)) {
		LOG_ERR("%s: device not ready\n", dev->name);
		return 0;
	}

	char testWrite[] = "This was written to flash_disk.";
	char testRead[sizeof(testWrite)];

	res = flash_write(dev, (off_t)20, testWrite, sizeof(testWrite));
	if (res != 0) {
		LOG_ERR("Flash write failed");
	}

	res = flash_read(dev, (off_t)20, testRead, sizeof(testRead));
	if (res != 0) {
		LOG_ERR("Flash read failed");
	}

	if (strcmp(testWrite, testRead) != 0) {
		LOG_ERR("Flash read return wrong data: \"%s\" != \"%s\"", testWrite, testRead);
	} else {
		LOG_INF("Read/Write test successful");
	}

	return 0;
}
```
